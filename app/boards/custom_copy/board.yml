## app/boards/custom_copy/board.yml
```yaml
board:
  name: custom_copy
  vendor: iomico
  #socs:
    #- name: nrf54l15
      #variants:
      #  - name: ns
      #    cpucluster: cpuapp
runners:
  run_once:
    '--recover':
      - runners:
          - nrfjprog
          - nrfutil
        run: first
        groups:
          - boards:
              - custom_copy
    '--erase':
      - runners:
          - nrfjprog
          - jlink
          - nrfutil
        run: first
        groups:
          - boards:
              - custom_copy
    '--reset':
      - runners:
          - nrfjprog
          - jlink
          - nrfutil
        run: last
        groups:
          - boards:
              - custom_copy
```

## app/boards/custom_scratch/Kconfig.custom_scratch
```kconfig
config BOARD_CUSTOM_SCRATCH
	select SOC_NRF54L15_CPUAPP
	select BOARD_LATE_INIT_HOOK
```

## app/our-driver-module/drivers/our_driver/Kconfig
```kconfig
menuconfig OUR_DRIVER
	bool "Our custom driver"
	default y
	depends on DT_HAS_OUR_DRIVER_ENABLED  # only enable if present inside dts.
	select GPIO
	help
	  Enable the custom driver for GPIO peripheral
```

## app/our-driver-module/dts/bindings/drivers/our,driver.yaml
```yaml
description: Our custom sensor driver binding.
compatible: "our,driver"

properties:
  gpios:
    type: phandle-array
    required: true
    description:
      The GPIO pin connected to our custom sensor (LED).
```
